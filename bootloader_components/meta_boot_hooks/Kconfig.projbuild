## bootloader_components/meta_boot_hooks/Kconfig.projbuild
```kconfig
menu "Zion firmware layout"
    config ZION_FACTORY_SIZE
        int "Zion factory application bytes"
        default 1507328
        range 1507328 3432448
endmenu
```

## examples/standalone-soundlab/sdkconfig.defaults
```kconfig
CONFIG_IDF_TARGET="esp32c3"
CONFIG_ESPTOOLPY_FLASHSIZE_8MB=y
CONFIG_PARTITION_TABLE_CUSTOM=y
CONFIG_PARTITION_TABLE_CUSTOM_FILENAME="partitions.csv"
CONFIG_ESP_CONSOLE_USB_SERIAL_JTAG=y
CONFIG_ESP_CONSOLE_SECONDARY_NONE=y
CONFIG_ESP_MAIN_TASK_STACK_SIZE=8192
CONFIG_LV_COLOR_DEPTH_16=y
CONFIG_FREERTOS_HZ=1000
CONFIG_LV_USE_CLIB_MALLOC=y
CONFIG_LV_USE_CLIB_STRING=y
CONFIG_LV_USE_CLIB_SPRINTF=y
```
