/* Generated from real application imports; link failure is a missing provider. */
ZION_AUTO_IMPORT(0,"IP_EVENT")
ZION_AUTO_IMPORT(1,"SC_EVENT")
ZION_AUTO_IMPORT(2,"WIFI_EVENT")
ZION_AUTO_IMPORT(3,"_ZNKSt7__cxx1112basic_stringIcSt11char_traitsIcESaIcEE17find_first_not_ofEPKcj")
ZION_AUTO_IMPORT(4,"_ZNKSt7__cxx1112basic_stringIcSt11char_traitsIcESaIcEE4findEPKcj")
ZION_AUTO_IMPORT(5,"_ZNKSt7__cxx1112basic_stringIcSt11char_traitsIcESaIcEE4findEcj")
ZION_AUTO_IMPORT(6,"_ZNKSt7__cxx1112basic_stringIcSt11char_traitsIcESaIcEE5rfindEPKcj")
ZION_AUTO_IMPORT(7,"_ZNKSt7__cxx1112basic_stringIcSt11char_traitsIcESaIcEE6substrEjj")
ZION_AUTO_IMPORT(8,"_ZNKSt7__cxx1112basic_stringIcSt11char_traitsIcESaIcEE7compareERKS4_")
ZION_AUTO_IMPORT(9,"_ZNSt7__cxx1112basic_stringIcSt11char_traitsIcESaIcEE10_M_disposeEv")
ZION_AUTO_IMPORT(10,"_ZNSt7__cxx1112basic_stringIcSt11char_traitsIcESaIcEE10_M_replaceEjjPKcj")
ZION_AUTO_IMPORT(11,"_ZNSt7__cxx1112basic_stringIcSt11char_traitsIcESaIcEE12_M_constructEjc")
ZION_AUTO_IMPORT(12,"_ZNSt7__cxx1112basic_stringIcSt11char_traitsIcESaIcEE4swapERS4_")
ZION_AUTO_IMPORT(13,"_ZNSt7__cxx1112basic_stringIcSt11char_traitsIcESaIcEE6appendEPKc")
ZION_AUTO_IMPORT(14,"_ZNSt7__cxx1112basic_stringIcSt11char_traitsIcESaIcEE6appendEPKcj")
ZION_AUTO_IMPORT(15,"_ZNSt7__cxx1112basic_stringIcSt11char_traitsIcESaIcEE6appendERKS4_")
ZION_AUTO_IMPORT(16,"_ZNSt7__cxx1112basic_stringIcSt11char_traitsIcESaIcEE6insertEjPKc")
ZION_AUTO_IMPORT(17,"_ZNSt7__cxx1112basic_stringIcSt11char_traitsIcESaIcEE6insertEjRKS4_")
ZION_AUTO_IMPORT(18,"_ZNSt7__cxx1112basic_stringIcSt11char_traitsIcESaIcEE7_S_copyEPcPKcj")
ZION_AUTO_IMPORT(19,"_ZNSt7__cxx1112basic_stringIcSt11char_traitsIcESaIcEE7reserveEj")
ZION_AUTO_IMPORT(20,"_ZNSt7__cxx1112basic_stringIcSt11char_traitsIcESaIcEE8_M_eraseEjj")
ZION_AUTO_IMPORT(21,"_ZNSt7__cxx1112basic_stringIcSt11char_traitsIcESaIcEE8pop_backEv")
ZION_AUTO_IMPORT(22,"_ZNSt7__cxx1112basic_stringIcSt11char_traitsIcESaIcEE9_M_appendEPKcj")
ZION_AUTO_IMPORT(23,"_ZNSt7__cxx1112basic_stringIcSt11char_traitsIcESaIcEE9_M_assignERKS4_")
ZION_AUTO_IMPORT(24,"_ZNSt7__cxx1112basic_stringIcSt11char_traitsIcESaIcEE9_M_createERjj")
ZION_AUTO_IMPORT(25,"_ZNSt7__cxx1112basic_stringIcSt11char_traitsIcESaIcEE9push_backEc")
ZION_AUTO_IMPORT(26,"_ZNSt7__cxx1112basic_stringIcSt11char_traitsIcESaIcEEC1EOS4_")
ZION_AUTO_IMPORT(27,"_ZNSt7__cxx1112basic_stringIcSt11char_traitsIcESaIcEEC1ERKS4_")
ZION_AUTO_IMPORT(28,"_ZSt17__throw_bad_allocv")
ZION_AUTO_IMPORT(29,"_ZSt18_Rb_tree_decrementPSt18_Rb_tree_node_base")
ZION_AUTO_IMPORT(30,"_ZSt18_Rb_tree_incrementPSt18_Rb_tree_node_base")
ZION_AUTO_IMPORT(31,"_ZSt19__throw_logic_errorPKc")
ZION_AUTO_IMPORT(32,"_ZSt20__throw_length_errorPKc")
ZION_AUTO_IMPORT(33,"_ZSt20__throw_system_errori")
ZION_AUTO_IMPORT(34,"_ZSt24__throw_out_of_range_fmtPKcz")
ZION_AUTO_IMPORT(35,"_ZSt25__throw_bad_function_callv")
ZION_AUTO_IMPORT(36,"_ZSt28__throw_bad_array_new_lengthv")
ZION_AUTO_IMPORT(37,"_ZSt29_Rb_tree_insert_and_rebalancebPSt18_Rb_tree_node_baseS0_RS_")
ZION_AUTO_IMPORT(38,"_ZSt7nothrow")
ZION_AUTO_IMPORT(39,"_ZdlPvj")
ZION_AUTO_IMPORT(40,"_Znwj")
ZION_AUTO_IMPORT(41,"_ZnwjRKSt9nothrow_t")
ZION_AUTO_IMPORT(42,"__adddf3")
ZION_AUTO_IMPORT(43,"__addsf3")
ZION_AUTO_IMPORT(44,"__ashldi3")
ZION_AUTO_IMPORT(45,"__assert_func")
ZION_AUTO_IMPORT(46,"__atomic_compare_exchange_1")
ZION_AUTO_IMPORT(47,"__atomic_compare_exchange_4")
ZION_AUTO_IMPORT(48,"__atomic_exchange_1")
ZION_AUTO_IMPORT(49,"__atomic_exchange_4")
ZION_AUTO_IMPORT(50,"__atomic_fetch_add_4")
ZION_AUTO_IMPORT(51,"__atomic_fetch_and_4")
ZION_AUTO_IMPORT(52,"__atomic_fetch_or_4")
ZION_AUTO_IMPORT(53,"__atomic_fetch_sub_4")
ZION_AUTO_IMPORT(54,"__atomic_load_8")
ZION_AUTO_IMPORT(55,"__atomic_store_8")
ZION_AUTO_IMPORT(56,"__bswapsi2")
ZION_AUTO_IMPORT(57,"__clzsi2")
ZION_AUTO_IMPORT(58,"__cxa_guard_acquire")
ZION_AUTO_IMPORT(59,"__cxa_guard_release")
ZION_AUTO_IMPORT(60,"__divdf3")
ZION_AUTO_IMPORT(61,"__divsf3")
ZION_AUTO_IMPORT(62,"__eqdf2")
ZION_AUTO_IMPORT(63,"__extendsfdf2")
ZION_AUTO_IMPORT(64,"__fixdfdi")
ZION_AUTO_IMPORT(65,"__fixdfsi")
ZION_AUTO_IMPORT(66,"__fixsfdi")
ZION_AUTO_IMPORT(67,"__fixsfsi")
ZION_AUTO_IMPORT(68,"__fixunsdfsi")
ZION_AUTO_IMPORT(69,"__fixunssfsi")
ZION_AUTO_IMPORT(70,"__floatdidf")
ZION_AUTO_IMPORT(71,"__floatdisf")
ZION_AUTO_IMPORT(72,"__floatsidf")
ZION_AUTO_IMPORT(73,"__floatsisf")
ZION_AUTO_IMPORT(74,"__floatundidf")
ZION_AUTO_IMPORT(75,"__floatunsidf")
ZION_AUTO_IMPORT(76,"__floatunsisf")
ZION_AUTO_IMPORT(77,"__gedf2")
ZION_AUTO_IMPORT(78,"__gesf2")
ZION_AUTO_IMPORT(79,"__gtdf2")
ZION_AUTO_IMPORT(80,"__gtsf2")
ZION_AUTO_IMPORT(81,"__ledf2")
ZION_AUTO_IMPORT(82,"__lesf2")
ZION_AUTO_IMPORT(83,"__lshrdi3")
ZION_AUTO_IMPORT(84,"__ltdf2")
ZION_AUTO_IMPORT(85,"__ltsf2")
ZION_AUTO_IMPORT(86,"__moddi3")
ZION_AUTO_IMPORT(87,"__muldf3")
ZION_AUTO_IMPORT(88,"__mulsf3")
ZION_AUTO_IMPORT(89,"__nedf2")
ZION_AUTO_IMPORT(90,"__subdf3")
ZION_AUTO_IMPORT(91,"__subsf3")
ZION_AUTO_IMPORT(92,"__unorddf2")
ZION_AUTO_IMPORT(93,"__unordsf2")
ZION_AUTO_IMPORT(94,"abs")
ZION_AUTO_IMPORT(95,"aligned_alloc")
ZION_AUTO_IMPORT(96,"atexit")
ZION_AUTO_IMPORT(97,"atoi")
ZION_AUTO_IMPORT(98,"audio_codec_delete_codec_if")
ZION_AUTO_IMPORT(99,"audio_codec_delete_ctrl_if")
ZION_AUTO_IMPORT(100,"audio_codec_delete_data_if")
ZION_AUTO_IMPORT(101,"audio_codec_delete_gpio_if")
ZION_AUTO_IMPORT(102,"audio_codec_new_gpio")
ZION_AUTO_IMPORT(103,"audio_codec_new_i2c_ctrl")
ZION_AUTO_IMPORT(104,"audio_codec_new_i2s_data")
ZION_AUTO_IMPORT(105,"ble_gap_adv_active")
ZION_AUTO_IMPORT(106,"ble_gap_adv_rsp_set_fields")
ZION_AUTO_IMPORT(107,"ble_gap_adv_set_fields")
ZION_AUTO_IMPORT(108,"ble_gap_adv_start")
ZION_AUTO_IMPORT(109,"ble_gap_adv_stop")
ZION_AUTO_IMPORT(110,"ble_gap_conn_find")
ZION_AUTO_IMPORT(111,"ble_gap_connect")
ZION_AUTO_IMPORT(112,"ble_gap_disc")
ZION_AUTO_IMPORT(113,"ble_gap_disc_active")
ZION_AUTO_IMPORT(114,"ble_gap_disc_cancel")
ZION_AUTO_IMPORT(115,"ble_gap_security_initiate")
ZION_AUTO_IMPORT(116,"ble_gap_terminate")
ZION_AUTO_IMPORT(117,"ble_gap_update_params")
ZION_AUTO_IMPORT(118,"ble_gattc_disc_all_chrs")
ZION_AUTO_IMPORT(119,"ble_gattc_disc_all_dscs")
ZION_AUTO_IMPORT(120,"ble_gattc_disc_svc_by_uuid")
ZION_AUTO_IMPORT(121,"ble_gattc_write_flat")
ZION_AUTO_IMPORT(122,"ble_gattc_write_no_rsp_flat")
ZION_AUTO_IMPORT(123,"ble_gatts_add_svcs")
ZION_AUTO_IMPORT(124,"ble_gatts_count_cfg")
ZION_AUTO_IMPORT(125,"ble_gatts_notify_custom")
ZION_AUTO_IMPORT(126,"ble_hs_adv_parse_fields")
ZION_AUTO_IMPORT(127,"ble_hs_cfg")
ZION_AUTO_IMPORT(128,"ble_hs_id_copy_addr")
ZION_AUTO_IMPORT(129,"ble_hs_id_infer_auto")
ZION_AUTO_IMPORT(130,"ble_hs_mbuf_from_flat")
ZION_AUTO_IMPORT(131,"ble_hs_mbuf_to_flat")
ZION_AUTO_IMPORT(132,"ble_hs_util_ensure_addr")
ZION_AUTO_IMPORT(133,"ble_sm_inject_io")
ZION_AUTO_IMPORT(134,"ble_store_clear")
ZION_AUTO_IMPORT(135,"ble_store_config_init")
ZION_AUTO_IMPORT(136,"ble_store_util_delete_peer")
ZION_AUTO_IMPORT(137,"ble_store_util_status_rr")
ZION_AUTO_IMPORT(138,"ble_svc_gap_device_appearance_set")
ZION_AUTO_IMPORT(139,"ble_svc_gap_device_name_set")
ZION_AUTO_IMPORT(140,"ble_svc_gap_init")
ZION_AUTO_IMPORT(141,"ble_svc_gatt_init")
ZION_AUTO_IMPORT(142,"ble_uuid_cmp")
ZION_AUTO_IMPORT(143,"bsp_audio_acquire")
ZION_AUTO_IMPORT(144,"bsp_audio_init")
ZION_AUTO_IMPORT(145,"bsp_audio_prepare_deep_sleep")
ZION_AUTO_IMPORT(146,"bsp_audio_read")
ZION_AUTO_IMPORT(147,"bsp_audio_release")
ZION_AUTO_IMPORT(148,"bsp_audio_set_format")
ZION_AUTO_IMPORT(149,"bsp_audio_set_volume")
ZION_AUTO_IMPORT(150,"bsp_audio_sleep")
ZION_AUTO_IMPORT(151,"bsp_audio_wake")
ZION_AUTO_IMPORT(152,"bsp_audio_write")
ZION_AUTO_IMPORT(153,"bsp_battery_log_status")
ZION_AUTO_IMPORT(154,"bsp_battery_mv")
ZION_AUTO_IMPORT(155,"bsp_battery_poll")
ZION_AUTO_IMPORT(156,"bsp_battery_sleep")
ZION_AUTO_IMPORT(157,"bsp_button_prepare_deep_sleep")
ZION_AUTO_IMPORT(158,"bsp_button_read_mv")
ZION_AUTO_IMPORT(159,"bsp_display_get_master_brightness")
ZION_AUTO_IMPORT(160,"bsp_display_io")
ZION_AUTO_IMPORT(161,"bsp_display_panel")
ZION_AUTO_IMPORT(162,"bsp_display_power")
ZION_AUTO_IMPORT(163,"bsp_display_prepare_deep_sleep")
ZION_AUTO_IMPORT(164,"bsp_display_set_master_brightness")
ZION_AUTO_IMPORT(165,"bsp_i2c_bus")
ZION_AUTO_IMPORT(166,"bsp_i2c_prepare_deep_sleep")
ZION_AUTO_IMPORT(167,"bsp_i2c_scan")
ZION_AUTO_IMPORT(168,"bsp_lvgl_set_landscape")
ZION_AUTO_IMPORT(169,"bsp_power_enter_deep_sleep")
ZION_AUTO_IMPORT(170,"bsp_power_wait_for_wake_release")
ZION_AUTO_IMPORT(171,"bzero")
ZION_AUTO_IMPORT(172,"cJSON_AddArrayToObject")
ZION_AUTO_IMPORT(173,"cJSON_AddBoolToObject")
ZION_AUTO_IMPORT(174,"cJSON_AddItemToArray")
ZION_AUTO_IMPORT(175,"cJSON_AddItemToObject")
ZION_AUTO_IMPORT(176,"cJSON_AddNumberToObject")
ZION_AUTO_IMPORT(177,"cJSON_AddStringToObject")
ZION_AUTO_IMPORT(178,"cJSON_CreateArray")
ZION_AUTO_IMPORT(179,"cJSON_CreateBool")
ZION_AUTO_IMPORT(180,"cJSON_CreateNull")
ZION_AUTO_IMPORT(181,"cJSON_CreateNumber")
ZION_AUTO_IMPORT(182,"cJSON_CreateObject")
ZION_AUTO_IMPORT(183,"cJSON_CreateString")
ZION_AUTO_IMPORT(184,"cJSON_Delete")
ZION_AUTO_IMPORT(185,"cJSON_DetachItemFromObject")
ZION_AUTO_IMPORT(186,"cJSON_GetObjectItem")
ZION_AUTO_IMPORT(187,"cJSON_GetObjectItemCaseSensitive")
ZION_AUTO_IMPORT(188,"cJSON_GetStringValue")
ZION_AUTO_IMPORT(189,"cJSON_IsArray")
ZION_AUTO_IMPORT(190,"cJSON_IsBool")
ZION_AUTO_IMPORT(191,"cJSON_IsNull")
ZION_AUTO_IMPORT(192,"cJSON_IsNumber")
ZION_AUTO_IMPORT(193,"cJSON_IsObject")
ZION_AUTO_IMPORT(194,"cJSON_IsString")
ZION_AUTO_IMPORT(195,"cJSON_IsTrue")
ZION_AUTO_IMPORT(196,"cJSON_Parse")
ZION_AUTO_IMPORT(197,"cJSON_ParseWithLength")
ZION_AUTO_IMPORT(198,"cJSON_PrintPreallocated")
ZION_AUTO_IMPORT(199,"cJSON_PrintUnformatted")
ZION_AUTO_IMPORT(200,"cJSON_free")
ZION_AUTO_IMPORT(201,"calloc")
ZION_AUTO_IMPORT(202,"ceilf")
ZION_AUTO_IMPORT(203,"close")
ZION_AUTO_IMPORT(204,"closedir")
ZION_AUTO_IMPORT(205,"cos")
ZION_AUTO_IMPORT(206,"cosf")
ZION_AUTO_IMPORT(207,"dns_getserver")
ZION_AUTO_IMPORT(208,"es8311_codec_new")
ZION_AUTO_IMPORT(209,"esp_app_get_description")
ZION_AUTO_IMPORT(210,"esp_audio_dec_register_default")
ZION_AUTO_IMPORT(211,"esp_audio_dec_unregister_default")
ZION_AUTO_IMPORT(212,"esp_audio_simple_dec_close")
ZION_AUTO_IMPORT(213,"esp_audio_simple_dec_get_info")
ZION_AUTO_IMPORT(214,"esp_audio_simple_dec_open")
ZION_AUTO_IMPORT(215,"esp_audio_simple_dec_process")
ZION_AUTO_IMPORT(216,"esp_audio_simple_dec_register_default")
ZION_AUTO_IMPORT(217,"esp_audio_simple_dec_unregister_default")
ZION_AUTO_IMPORT(218,"esp_codec_dev_close")
ZION_AUTO_IMPORT(219,"esp_codec_dev_delete")
ZION_AUTO_IMPORT(220,"esp_codec_dev_new")
ZION_AUTO_IMPORT(221,"esp_codec_dev_open")
ZION_AUTO_IMPORT(222,"esp_codec_dev_read")
ZION_AUTO_IMPORT(223,"esp_codec_dev_set_in_gain")
ZION_AUTO_IMPORT(224,"esp_codec_dev_set_out_mute")
ZION_AUTO_IMPORT(225,"esp_codec_dev_set_out_vol")
ZION_AUTO_IMPORT(226,"esp_codec_dev_set_vol_curve")
ZION_AUTO_IMPORT(227,"esp_codec_dev_write")
ZION_AUTO_IMPORT(228,"esp_crt_bundle_attach")
ZION_AUTO_IMPORT(229,"esp_deep_sleep_start")
ZION_AUTO_IMPORT(230,"esp_efuse_mac_get_default")
ZION_AUTO_IMPORT(231,"esp_err_to_name")
ZION_AUTO_IMPORT(232,"esp_event_handler_instance_register")
ZION_AUTO_IMPORT(233,"esp_event_handler_instance_unregister")
ZION_AUTO_IMPORT(234,"esp_event_handler_register")
ZION_AUTO_IMPORT(235,"esp_event_loop_create_default")
ZION_AUTO_IMPORT(236,"esp_event_post")
ZION_AUTO_IMPORT(237,"esp_fill_random")
ZION_AUTO_IMPORT(238,"esp_get_idf_version")
ZION_AUTO_IMPORT(239,"esp_get_minimum_free_heap_size")
ZION_AUTO_IMPORT(240,"esp_hidd_dev_battery_set")
ZION_AUTO_IMPORT(241,"esp_hidd_dev_init")
ZION_AUTO_IMPORT(242,"esp_hidd_dev_input_set")
ZION_AUTO_IMPORT(243,"esp_http_client_cleanup")
ZION_AUTO_IMPORT(244,"esp_http_client_close")
ZION_AUTO_IMPORT(245,"esp_http_client_delete_header")
ZION_AUTO_IMPORT(246,"esp_http_client_fetch_headers")
ZION_AUTO_IMPORT(247,"esp_http_client_get_content_length")
ZION_AUTO_IMPORT(248,"esp_http_client_get_status_code")
ZION_AUTO_IMPORT(249,"esp_http_client_get_url")
ZION_AUTO_IMPORT(250,"esp_http_client_init")
ZION_AUTO_IMPORT(251,"esp_http_client_is_complete_data_received")
ZION_AUTO_IMPORT(252,"esp_http_client_open")
ZION_AUTO_IMPORT(253,"esp_http_client_perform")
ZION_AUTO_IMPORT(254,"esp_http_client_read")
ZION_AUTO_IMPORT(255,"esp_http_client_set_header")
ZION_AUTO_IMPORT(256,"esp_http_client_set_method")
ZION_AUTO_IMPORT(257,"esp_http_client_set_post_field")
ZION_AUTO_IMPORT(258,"esp_http_client_set_redirection")
ZION_AUTO_IMPORT(259,"esp_http_client_set_timeout_ms")
ZION_AUTO_IMPORT(260,"esp_http_client_write")
ZION_AUTO_IMPORT(261,"esp_ip4addr_ntoa")
ZION_AUTO_IMPORT(262,"esp_lcd_new_panel_io_spi")
ZION_AUTO_IMPORT(263,"esp_lcd_new_panel_st7789")
ZION_AUTO_IMPORT(264,"esp_lcd_panel_disp_on_off")
ZION_AUTO_IMPORT(265,"esp_lcd_panel_draw_bitmap")
ZION_AUTO_IMPORT(266,"esp_lcd_panel_init")
ZION_AUTO_IMPORT(267,"esp_lcd_panel_invert_color")
ZION_AUTO_IMPORT(268,"esp_lcd_panel_io_tx_param")
ZION_AUTO_IMPORT(269,"esp_lcd_panel_reset")
ZION_AUTO_IMPORT(270,"esp_light_sleep_start")
ZION_AUTO_IMPORT(271,"esp_log_default_level")
ZION_AUTO_IMPORT(272,"esp_log_level_get")
ZION_AUTO_IMPORT(273,"esp_log_level_set")
ZION_AUTO_IMPORT(274,"esp_mbedtls_dynamic_set_rx_buf_static")
ZION_AUTO_IMPORT(275,"esp_mbedtls_mem_calloc")
ZION_AUTO_IMPORT(276,"esp_mbedtls_mem_free")
ZION_AUTO_IMPORT(277,"esp_mqtt_client_destroy")
ZION_AUTO_IMPORT(278,"esp_mqtt_client_init")
ZION_AUTO_IMPORT(279,"esp_mqtt_client_publish")
ZION_AUTO_IMPORT(280,"esp_mqtt_client_register_event")
ZION_AUTO_IMPORT(281,"esp_mqtt_client_start")
ZION_AUTO_IMPORT(282,"esp_mqtt_client_stop")
ZION_AUTO_IMPORT(283,"esp_mqtt_client_subscribe_single")
ZION_AUTO_IMPORT(284,"esp_netif_create_default_wifi_ap")
ZION_AUTO_IMPORT(285,"esp_netif_create_default_wifi_sta")
ZION_AUTO_IMPORT(286,"esp_netif_destroy_default_wifi")
ZION_AUTO_IMPORT(287,"esp_netif_dhcps_start")
ZION_AUTO_IMPORT(288,"esp_netif_dhcps_stop")
ZION_AUTO_IMPORT(289,"esp_netif_get_dns_info")
ZION_AUTO_IMPORT(290,"esp_netif_get_handle_from_ifkey")
ZION_AUTO_IMPORT(291,"esp_netif_get_ip_info")
ZION_AUTO_IMPORT(292,"esp_netif_init")
ZION_AUTO_IMPORT(293,"esp_netif_set_dns_info")
ZION_AUTO_IMPORT(294,"esp_netif_set_hostname")
ZION_AUTO_IMPORT(295,"esp_netif_set_ip_info")
ZION_AUTO_IMPORT(296,"esp_netif_sntp_deinit")
ZION_AUTO_IMPORT(297,"esp_netif_sntp_init")
ZION_AUTO_IMPORT(298,"esp_netif_sntp_start")
ZION_AUTO_IMPORT(299,"esp_netif_sntp_sync_wait")
ZION_AUTO_IMPORT(300,"esp_netif_str_to_ip4")
ZION_AUTO_IMPORT(301,"esp_now_add_peer")
ZION_AUTO_IMPORT(302,"esp_now_deinit")
ZION_AUTO_IMPORT(303,"esp_now_del_peer")
ZION_AUTO_IMPORT(304,"esp_now_init")
ZION_AUTO_IMPORT(305,"esp_now_register_recv_cb")
ZION_AUTO_IMPORT(306,"esp_now_send")
ZION_AUTO_IMPORT(307,"esp_now_unregister_recv_cb")
ZION_AUTO_IMPORT(308,"esp_opus_dec_close")
ZION_AUTO_IMPORT(309,"esp_opus_dec_decode")
ZION_AUTO_IMPORT(310,"esp_opus_dec_open")
ZION_AUTO_IMPORT(311,"esp_opus_enc_close")
ZION_AUTO_IMPORT(312,"esp_opus_enc_get_frame_size")
ZION_AUTO_IMPORT(313,"esp_opus_enc_open")
ZION_AUTO_IMPORT(314,"esp_opus_enc_process")
ZION_AUTO_IMPORT(315,"esp_ota_get_running_partition")
ZION_AUTO_IMPORT(316,"esp_ota_get_state_partition")
ZION_AUTO_IMPORT(317,"esp_partition_find_first")
ZION_AUTO_IMPORT(318,"esp_partition_read")
ZION_AUTO_IMPORT(319,"esp_pm_configure")
ZION_AUTO_IMPORT(320,"esp_pm_get_configuration")
ZION_AUTO_IMPORT(321,"esp_pm_lock_acquire")
ZION_AUTO_IMPORT(322,"esp_pm_lock_create")
ZION_AUTO_IMPORT(323,"esp_pm_lock_release")
ZION_AUTO_IMPORT(324,"esp_random")
ZION_AUTO_IMPORT(325,"esp_read_mac")
ZION_AUTO_IMPORT(326,"esp_reset_reason")
ZION_AUTO_IMPORT(327,"esp_restart")
ZION_AUTO_IMPORT(328,"esp_rom_printf")
ZION_AUTO_IMPORT(329,"esp_sleep_disable_wakeup_source")
ZION_AUTO_IMPORT(330,"esp_sleep_enable_gpio_wakeup_on_hp_periph_powerdown")
ZION_AUTO_IMPORT(331,"esp_sleep_enable_timer_wakeup")
ZION_AUTO_IMPORT(332,"esp_sleep_get_wakeup_cause")
ZION_AUTO_IMPORT(333,"esp_sleep_get_wakeup_causes")
ZION_AUTO_IMPORT(334,"esp_smartconfig_start")
ZION_AUTO_IMPORT(335,"esp_smartconfig_stop")
ZION_AUTO_IMPORT(336,"esp_sntp_enabled")
ZION_AUTO_IMPORT(337,"esp_sntp_init")
ZION_AUTO_IMPORT(338,"esp_sntp_setoperatingmode")
ZION_AUTO_IMPORT(339,"esp_sntp_setservername")
ZION_AUTO_IMPORT(340,"esp_sntp_stop")
ZION_AUTO_IMPORT(341,"esp_spiffs_info")
ZION_AUTO_IMPORT(342,"esp_supp_dpp_bootstrap_gen")
ZION_AUTO_IMPORT(343,"esp_supp_dpp_deinit")
ZION_AUTO_IMPORT(344,"esp_supp_dpp_init")
ZION_AUTO_IMPORT(345,"esp_supp_dpp_start_listen")
ZION_AUTO_IMPORT(346,"esp_supp_dpp_stop_listen")
ZION_AUTO_IMPORT(347,"esp_timer_create")
ZION_AUTO_IMPORT(348,"esp_timer_delete")
ZION_AUTO_IMPORT(349,"esp_timer_is_active")
ZION_AUTO_IMPORT(350,"esp_timer_start_once")
ZION_AUTO_IMPORT(351,"esp_timer_start_periodic")
ZION_AUTO_IMPORT(352,"esp_timer_stop")
ZION_AUTO_IMPORT(353,"esp_tls_conn_destroy")
ZION_AUTO_IMPORT(354,"esp_tls_conn_new_async")
ZION_AUTO_IMPORT(355,"esp_tls_conn_new_sync")
ZION_AUTO_IMPORT(356,"esp_tls_conn_read")
ZION_AUTO_IMPORT(357,"esp_tls_conn_write")
ZION_AUTO_IMPORT(358,"esp_tls_get_bytes_avail")
ZION_AUTO_IMPORT(359,"esp_tls_get_conn_sockfd")
ZION_AUTO_IMPORT(360,"esp_tls_get_ssl_context")
ZION_AUTO_IMPORT(361,"esp_tls_init")
ZION_AUTO_IMPORT(362,"esp_tls_set_conn_sockfd")
ZION_AUTO_IMPORT(363,"esp_tls_set_conn_state")
ZION_AUTO_IMPORT(364,"esp_vfs_fat_info")
ZION_AUTO_IMPORT(365,"esp_vfs_fat_spiflash_mount_rw_wl")
ZION_AUTO_IMPORT(366,"esp_vfs_fat_spiflash_unmount_rw_wl")
ZION_AUTO_IMPORT(367,"esp_vfs_spiffs_register")
ZION_AUTO_IMPORT(368,"esp_websocket_client_destroy")
ZION_AUTO_IMPORT(369,"esp_websocket_client_init")
ZION_AUTO_IMPORT(370,"esp_websocket_client_is_connected")
ZION_AUTO_IMPORT(371,"esp_websocket_client_send_bin")
ZION_AUTO_IMPORT(372,"esp_websocket_client_send_text")
ZION_AUTO_IMPORT(373,"esp_websocket_client_start")
ZION_AUTO_IMPORT(374,"esp_websocket_client_stop")
ZION_AUTO_IMPORT(375,"esp_websocket_register_events")
ZION_AUTO_IMPORT(376,"esp_wifi_clear_ap_list")
ZION_AUTO_IMPORT(377,"esp_wifi_connect")
ZION_AUTO_IMPORT(378,"esp_wifi_deinit")
ZION_AUTO_IMPORT(379,"esp_wifi_disconnect")
ZION_AUTO_IMPORT(380,"esp_wifi_get_channel")
ZION_AUTO_IMPORT(381,"esp_wifi_get_config")
ZION_AUTO_IMPORT(382,"esp_wifi_get_max_tx_power")
ZION_AUTO_IMPORT(383,"esp_wifi_get_mode")
ZION_AUTO_IMPORT(384,"esp_wifi_init")
ZION_AUTO_IMPORT(385,"esp_wifi_scan_get_ap_num")
ZION_AUTO_IMPORT(386,"esp_wifi_scan_get_ap_record")
ZION_AUTO_IMPORT(387,"esp_wifi_scan_get_ap_records")
ZION_AUTO_IMPORT(388,"esp_wifi_scan_start")
ZION_AUTO_IMPORT(389,"esp_wifi_scan_stop")
ZION_AUTO_IMPORT(390,"esp_wifi_set_band_mode")
ZION_AUTO_IMPORT(391,"esp_wifi_set_channel")
ZION_AUTO_IMPORT(392,"esp_wifi_set_config")
ZION_AUTO_IMPORT(393,"esp_wifi_set_max_tx_power")
ZION_AUTO_IMPORT(394,"esp_wifi_set_mode")
ZION_AUTO_IMPORT(395,"esp_wifi_set_ps")
ZION_AUTO_IMPORT(396,"esp_wifi_set_storage")
ZION_AUTO_IMPORT(397,"esp_wifi_sta_get_ap_info")
ZION_AUTO_IMPORT(398,"esp_wifi_start")
ZION_AUTO_IMPORT(399,"esp_wifi_stop")
ZION_AUTO_IMPORT(400,"exit")
ZION_AUTO_IMPORT(401,"expf")
ZION_AUTO_IMPORT(402,"fabs")
ZION_AUTO_IMPORT(403,"fabsf")
ZION_AUTO_IMPORT(404,"fclose")
ZION_AUTO_IMPORT(405,"fcntl")
ZION_AUTO_IMPORT(406,"ferror")
ZION_AUTO_IMPORT(407,"fflush")
ZION_AUTO_IMPORT(408,"fgetc")
ZION_AUTO_IMPORT(409,"fileno")
ZION_AUTO_IMPORT(410,"floor")
ZION_AUTO_IMPORT(411,"floorf")
ZION_AUTO_IMPORT(412,"fmax")
ZION_AUTO_IMPORT(413,"fmin")
ZION_AUTO_IMPORT(414,"fmodf")
ZION_AUTO_IMPORT(415,"fopen")
ZION_AUTO_IMPORT(416,"fread")
ZION_AUTO_IMPORT(417,"free")
ZION_AUTO_IMPORT(418,"fseek")
ZION_AUTO_IMPORT(419,"fsync")
ZION_AUTO_IMPORT(420,"ftell")
ZION_AUTO_IMPORT(421,"ftruncate")
ZION_AUTO_IMPORT(422,"fwrite")
ZION_AUTO_IMPORT(423,"g_wifi_default_wpa_crypto_funcs")
ZION_AUTO_IMPORT(424,"g_wifi_osi_funcs")
ZION_AUTO_IMPORT(425,"gettimeofday")
ZION_AUTO_IMPORT(426,"gmtime_r")
ZION_AUTO_IMPORT(427,"gpio_config")
ZION_AUTO_IMPORT(428,"gpio_deep_sleep_hold_en")
ZION_AUTO_IMPORT(429,"gpio_get_level")
ZION_AUTO_IMPORT(430,"gpio_hold_dis")
ZION_AUTO_IMPORT(431,"gpio_hold_en")
ZION_AUTO_IMPORT(432,"gpio_set_level")
ZION_AUTO_IMPORT(433,"heap_caps_aligned_alloc")
ZION_AUTO_IMPORT(434,"heap_caps_calloc")
ZION_AUTO_IMPORT(435,"heap_caps_check_integrity_all")
ZION_AUTO_IMPORT(436,"heap_caps_free")
ZION_AUTO_IMPORT(437,"heap_caps_get_free_size")
ZION_AUTO_IMPORT(438,"heap_caps_get_largest_free_block")
ZION_AUTO_IMPORT(439,"heap_caps_malloc")
ZION_AUTO_IMPORT(440,"heap_caps_print_heap_info")
ZION_AUTO_IMPORT(441,"heap_caps_register_failed_alloc_callback")
ZION_AUTO_IMPORT(442,"httpd_query_key_value")
ZION_AUTO_IMPORT(443,"httpd_register_err_handler")
ZION_AUTO_IMPORT(444,"httpd_register_uri_handler")
ZION_AUTO_IMPORT(445,"httpd_req_get_hdr_value_len")
ZION_AUTO_IMPORT(446,"httpd_req_get_hdr_value_str")
ZION_AUTO_IMPORT(447,"httpd_req_get_url_query_len")
ZION_AUTO_IMPORT(448,"httpd_req_get_url_query_str")
ZION_AUTO_IMPORT(449,"httpd_req_recv")
ZION_AUTO_IMPORT(450,"httpd_req_to_sockfd")
ZION_AUTO_IMPORT(451,"httpd_resp_send")
ZION_AUTO_IMPORT(452,"httpd_resp_send_chunk")
ZION_AUTO_IMPORT(453,"httpd_resp_send_err")
ZION_AUTO_IMPORT(454,"httpd_resp_set_hdr")
ZION_AUTO_IMPORT(455,"httpd_resp_set_status")
ZION_AUTO_IMPORT(456,"httpd_resp_set_type")
ZION_AUTO_IMPORT(457,"httpd_send")
ZION_AUTO_IMPORT(458,"httpd_start")
ZION_AUTO_IMPORT(459,"httpd_stop")
ZION_AUTO_IMPORT(460,"httpd_uri_match_wildcard")
ZION_AUTO_IMPORT(461,"i2c_del_master_bus")
ZION_AUTO_IMPORT(462,"i2c_master_bus_add_device")
ZION_AUTO_IMPORT(463,"i2c_master_bus_rm_device")
ZION_AUTO_IMPORT(464,"i2c_master_transmit_receive")
ZION_AUTO_IMPORT(465,"i2c_new_master_bus")
ZION_AUTO_IMPORT(466,"i2s_channel_disable")
ZION_AUTO_IMPORT(467,"i2s_channel_enable")
ZION_AUTO_IMPORT(468,"i2s_channel_init_std_mode")
ZION_AUTO_IMPORT(469,"i2s_del_channel")
ZION_AUTO_IMPORT(470,"i2s_new_channel")
ZION_AUTO_IMPORT(471,"iot_button_get_pressed_time")
ZION_AUTO_IMPORT(472,"iot_button_new_adc_device")
ZION_AUTO_IMPORT(473,"iot_button_register_cb")
ZION_AUTO_IMPORT(474,"ip4addr_ntoa")
ZION_AUTO_IMPORT(475,"ipaddr_addr")
ZION_AUTO_IMPORT(476,"isalnum")
ZION_AUTO_IMPORT(477,"jd_decomp")
ZION_AUTO_IMPORT(478,"jd_prepare")
ZION_AUTO_IMPORT(479,"labs")
ZION_AUTO_IMPORT(480,"localtime")
ZION_AUTO_IMPORT(481,"localtime_r")
ZION_AUTO_IMPORT(482,"log10f")
ZION_AUTO_IMPORT(483,"lrintf")
ZION_AUTO_IMPORT(484,"lround")
ZION_AUTO_IMPORT(485,"lroundf")
ZION_AUTO_IMPORT(486,"lv_anim_delete")
ZION_AUTO_IMPORT(487,"lv_anim_get_user_data")
ZION_AUTO_IMPORT(488,"lv_anim_init")
ZION_AUTO_IMPORT(489,"lv_anim_path_ease_in")
ZION_AUTO_IMPORT(490,"lv_anim_path_ease_in_out")
ZION_AUTO_IMPORT(491,"lv_anim_path_ease_out")
ZION_AUTO_IMPORT(492,"lv_anim_path_overshoot")
ZION_AUTO_IMPORT(493,"lv_anim_path_step")
ZION_AUTO_IMPORT(494,"lv_anim_set_completed_cb")
ZION_AUTO_IMPORT(495,"lv_anim_set_delay")
ZION_AUTO_IMPORT(496,"lv_anim_set_duration")
ZION_AUTO_IMPORT(497,"lv_anim_set_exec_cb")
ZION_AUTO_IMPORT(498,"lv_anim_set_path_cb")
ZION_AUTO_IMPORT(499,"lv_anim_set_repeat_count")
ZION_AUTO_IMPORT(500,"lv_anim_set_repeat_delay")
ZION_AUTO_IMPORT(501,"lv_anim_set_reverse_duration")
ZION_AUTO_IMPORT(502,"lv_anim_set_user_data")
ZION_AUTO_IMPORT(503,"lv_anim_set_values")
ZION_AUTO_IMPORT(504,"lv_anim_set_var")
ZION_AUTO_IMPORT(505,"lv_anim_start")
ZION_AUTO_IMPORT(506,"lv_arc_create")
ZION_AUTO_IMPORT(507,"lv_arc_set_bg_angles")
ZION_AUTO_IMPORT(508,"lv_area_get_width")
ZION_AUTO_IMPORT(509,"lv_area_increase")
ZION_AUTO_IMPORT(510,"lv_bar_create")
ZION_AUTO_IMPORT(511,"lv_bar_set_range")
ZION_AUTO_IMPORT(512,"lv_bar_set_value")
ZION_AUTO_IMPORT(513,"lv_color_black")
ZION_AUTO_IMPORT(514,"lv_color_eq")
ZION_AUTO_IMPORT(515,"lv_color_mix")
ZION_AUTO_IMPORT(516,"lv_color_to_32")
ZION_AUTO_IMPORT(517,"lv_color_white")
ZION_AUTO_IMPORT(518,"lv_display_add_event_cb")
ZION_AUTO_IMPORT(519,"lv_display_enable_invalidation")
ZION_AUTO_IMPORT(520,"lv_display_flush_ready")
ZION_AUTO_IMPORT(521,"lv_display_get_color_format")
ZION_AUTO_IMPORT(522,"lv_display_get_default")
ZION_AUTO_IMPORT(523,"lv_display_get_horizontal_resolution")
ZION_AUTO_IMPORT(524,"lv_display_get_layer_top")
ZION_AUTO_IMPORT(525,"lv_display_get_refr_timer")
ZION_AUTO_IMPORT(526,"lv_display_get_vertical_resolution")
ZION_AUTO_IMPORT(527,"lv_display_is_invalidation_enabled")
ZION_AUTO_IMPORT(528,"lv_display_set_flush_cb")
ZION_AUTO_IMPORT(529,"lv_draw_arc")
ZION_AUTO_IMPORT(530,"lv_draw_arc_dsc_init")
ZION_AUTO_IMPORT(531,"lv_draw_border")
ZION_AUTO_IMPORT(532,"lv_draw_border_dsc_init")
ZION_AUTO_IMPORT(533,"lv_draw_buf_clear")
ZION_AUTO_IMPORT(534,"lv_draw_buf_goto_xy")
ZION_AUTO_IMPORT(535,"lv_draw_buf_init")
ZION_AUTO_IMPORT(536,"lv_draw_buf_width_to_stride")
ZION_AUTO_IMPORT(537,"lv_draw_dispatch")
ZION_AUTO_IMPORT(538,"lv_draw_dispatch_wait_for_request")
ZION_AUTO_IMPORT(539,"lv_draw_line")
ZION_AUTO_IMPORT(540,"lv_draw_line_dsc_init")
ZION_AUTO_IMPORT(541,"lv_draw_rect")
ZION_AUTO_IMPORT(542,"lv_draw_rect_dsc_init")
ZION_AUTO_IMPORT(543,"lv_draw_unit_send_event")
ZION_AUTO_IMPORT(544,"lv_event_free_user_data_cb")
ZION_AUTO_IMPORT(545,"lv_event_get_code")
ZION_AUTO_IMPORT(546,"lv_event_get_layer")
ZION_AUTO_IMPORT(547,"lv_event_get_target")
ZION_AUTO_IMPORT(548,"lv_event_get_target_obj")
ZION_AUTO_IMPORT(549,"lv_event_get_user_data")
ZION_AUTO_IMPORT(550,"lv_event_set_cover_res")
ZION_AUTO_IMPORT(551,"lv_font_get_bitmap_fmt_txt")
ZION_AUTO_IMPORT(552,"lv_font_get_glyph_dsc")
ZION_AUTO_IMPORT(553,"lv_font_get_glyph_dsc_fmt_txt")
ZION_AUTO_IMPORT(554,"lv_font_get_line_height")
ZION_AUTO_IMPORT(555,"lv_font_montserrat_14")
ZION_AUTO_IMPORT(556,"lv_font_montserrat_16")
ZION_AUTO_IMPORT(557,"lv_font_montserrat_20")
ZION_AUTO_IMPORT(558,"lv_image_cache_drop")
ZION_AUTO_IMPORT(559,"lv_image_create")
ZION_AUTO_IMPORT(560,"lv_image_set_antialias")
ZION_AUTO_IMPORT(561,"lv_image_set_inner_align")
ZION_AUTO_IMPORT(562,"lv_image_set_pivot")
ZION_AUTO_IMPORT(563,"lv_image_set_scale")
ZION_AUTO_IMPORT(564,"lv_image_set_src")
ZION_AUTO_IMPORT(565,"lv_label_get_text")
ZION_AUTO_IMPORT(566,"lv_label_set_long_mode")
ZION_AUTO_IMPORT(567,"lv_label_set_recolor")
ZION_AUTO_IMPORT(568,"lv_label_set_text_fmt")
ZION_AUTO_IMPORT(569,"lv_label_set_text_static")
ZION_AUTO_IMPORT(570,"lv_layer_init")
ZION_AUTO_IMPORT(571,"lv_layer_top")
ZION_AUTO_IMPORT(572,"lv_malloc_zeroed")
ZION_AUTO_IMPORT(573,"lv_mem_monitor")
ZION_AUTO_IMPORT(574,"lv_obj_add_event_cb")
ZION_AUTO_IMPORT(575,"lv_obj_add_flag")
ZION_AUTO_IMPORT(576,"lv_obj_add_style")
ZION_AUTO_IMPORT(577,"lv_obj_align")
ZION_AUTO_IMPORT(578,"lv_obj_center")
ZION_AUTO_IMPORT(579,"lv_obj_clean")
ZION_AUTO_IMPORT(580,"lv_obj_delete")
ZION_AUTO_IMPORT(581,"lv_obj_get_child")
ZION_AUTO_IMPORT(582,"lv_obj_get_child_count")
ZION_AUTO_IMPORT(583,"lv_obj_get_coords")
ZION_AUTO_IMPORT(584,"lv_obj_get_display")
ZION_AUTO_IMPORT(585,"lv_obj_get_height")
ZION_AUTO_IMPORT(586,"lv_obj_get_parent")
ZION_AUTO_IMPORT(587,"lv_obj_get_scroll_y")
ZION_AUTO_IMPORT(588,"lv_obj_get_style_prop")
ZION_AUTO_IMPORT(589,"lv_obj_get_user_data")
ZION_AUTO_IMPORT(590,"lv_obj_get_width")
ZION_AUTO_IMPORT(591,"lv_obj_get_x")
ZION_AUTO_IMPORT(592,"lv_obj_get_y")
ZION_AUTO_IMPORT(593,"lv_obj_has_flag")
ZION_AUTO_IMPORT(594,"lv_obj_invalidate")
ZION_AUTO_IMPORT(595,"lv_obj_invalidate_area")
ZION_AUTO_IMPORT(596,"lv_obj_move_to_index")
ZION_AUTO_IMPORT(597,"lv_obj_redraw")
ZION_AUTO_IMPORT(598,"lv_obj_remove_flag")
ZION_AUTO_IMPORT(599,"lv_obj_remove_style")
ZION_AUTO_IMPORT(600,"lv_obj_remove_style_all")
ZION_AUTO_IMPORT(601,"lv_obj_scroll_by")
ZION_AUTO_IMPORT(602,"lv_obj_scroll_to_view")
ZION_AUTO_IMPORT(603,"lv_obj_scroll_to_y")
ZION_AUTO_IMPORT(604,"lv_obj_set_flag")
ZION_AUTO_IMPORT(605,"lv_obj_set_flex_align")
ZION_AUTO_IMPORT(606,"lv_obj_set_flex_flow")
ZION_AUTO_IMPORT(607,"lv_obj_set_scroll_dir")
ZION_AUTO_IMPORT(608,"lv_obj_set_scrollbar_mode")
ZION_AUTO_IMPORT(609,"lv_obj_set_style_anim_duration")
ZION_AUTO_IMPORT(610,"lv_obj_set_style_arc_color")
ZION_AUTO_IMPORT(611,"lv_obj_set_style_arc_opa")
ZION_AUTO_IMPORT(612,"lv_obj_set_style_arc_width")
ZION_AUTO_IMPORT(613,"lv_obj_set_style_bg_grad_color")
ZION_AUTO_IMPORT(614,"lv_obj_set_style_bg_grad_dir")
ZION_AUTO_IMPORT(615,"lv_obj_set_style_border_color")
ZION_AUTO_IMPORT(616,"lv_obj_set_style_border_opa")
ZION_AUTO_IMPORT(617,"lv_obj_set_style_border_side")
ZION_AUTO_IMPORT(618,"lv_obj_set_style_border_width")
ZION_AUTO_IMPORT(619,"lv_obj_set_style_clip_corner")
ZION_AUTO_IMPORT(620,"lv_obj_set_style_image_colorkey")
ZION_AUTO_IMPORT(621,"lv_obj_set_style_image_opa")
ZION_AUTO_IMPORT(622,"lv_obj_set_style_image_recolor")
ZION_AUTO_IMPORT(623,"lv_obj_set_style_image_recolor_opa")
ZION_AUTO_IMPORT(624,"lv_obj_set_style_opa")
ZION_AUTO_IMPORT(625,"lv_obj_set_style_outline_width")
ZION_AUTO_IMPORT(626,"lv_obj_set_style_pad_bottom")
ZION_AUTO_IMPORT(627,"lv_obj_set_style_pad_left")
ZION_AUTO_IMPORT(628,"lv_obj_set_style_pad_right")
ZION_AUTO_IMPORT(629,"lv_obj_set_style_pad_row")
ZION_AUTO_IMPORT(630,"lv_obj_set_style_pad_top")
ZION_AUTO_IMPORT(631,"lv_obj_set_style_radius")
ZION_AUTO_IMPORT(632,"lv_obj_set_style_shadow_color")
ZION_AUTO_IMPORT(633,"lv_obj_set_style_shadow_opa")
ZION_AUTO_IMPORT(634,"lv_obj_set_style_shadow_spread")
ZION_AUTO_IMPORT(635,"lv_obj_set_style_shadow_width")
ZION_AUTO_IMPORT(636,"lv_obj_set_style_text_align")
ZION_AUTO_IMPORT(637,"lv_obj_set_style_text_letter_space")
ZION_AUTO_IMPORT(638,"lv_obj_set_style_text_line_space")
ZION_AUTO_IMPORT(639,"lv_obj_set_style_text_opa")
ZION_AUTO_IMPORT(640,"lv_obj_set_style_transform_height")
ZION_AUTO_IMPORT(641,"lv_obj_set_style_transform_pivot_x")
ZION_AUTO_IMPORT(642,"lv_obj_set_style_transform_pivot_y")
ZION_AUTO_IMPORT(643,"lv_obj_set_style_transform_rotation")
ZION_AUTO_IMPORT(644,"lv_obj_set_style_transform_scale_x")
ZION_AUTO_IMPORT(645,"lv_obj_set_style_transform_scale_y")
ZION_AUTO_IMPORT(646,"lv_obj_set_style_transform_width")
ZION_AUTO_IMPORT(647,"lv_obj_set_user_data")
ZION_AUTO_IMPORT(648,"lv_obj_set_x")
ZION_AUTO_IMPORT(649,"lv_obj_set_y")
ZION_AUTO_IMPORT(650,"lv_obj_update_layout")
ZION_AUTO_IMPORT(651,"lv_pct")
ZION_AUTO_IMPORT(652,"lv_qrcode_create")
ZION_AUTO_IMPORT(653,"lv_qrcode_set_dark_color")
ZION_AUTO_IMPORT(654,"lv_qrcode_set_light_color")
ZION_AUTO_IMPORT(655,"lv_qrcode_set_size")
ZION_AUTO_IMPORT(656,"lv_qrcode_update")
ZION_AUTO_IMPORT(657,"lv_refr_get_disp_refreshing")
ZION_AUTO_IMPORT(658,"lv_refr_now")
ZION_AUTO_IMPORT(659,"lv_refr_set_disp_refreshing")
ZION_AUTO_IMPORT(660,"lv_screen_active")
ZION_AUTO_IMPORT(661,"lv_snprintf")
ZION_AUTO_IMPORT(662,"lv_style_init")
ZION_AUTO_IMPORT(663,"lv_style_reset")
ZION_AUTO_IMPORT(664,"lv_style_set_bg_color")
ZION_AUTO_IMPORT(665,"lv_style_set_bg_opa")
ZION_AUTO_IMPORT(666,"lv_style_set_border_width")
ZION_AUTO_IMPORT(667,"lv_style_set_pad_bottom")
ZION_AUTO_IMPORT(668,"lv_style_set_pad_left")
ZION_AUTO_IMPORT(669,"lv_style_set_pad_right")
ZION_AUTO_IMPORT(670,"lv_style_set_pad_top")
ZION_AUTO_IMPORT(671,"lv_style_set_radius")
ZION_AUTO_IMPORT(672,"lv_text_get_size")
ZION_AUTO_IMPORT(673,"lv_tick_get")
ZION_AUTO_IMPORT(674,"lv_timer_create")
ZION_AUTO_IMPORT(675,"lv_timer_delete")
ZION_AUTO_IMPORT(676,"lv_timer_pause")
ZION_AUTO_IMPORT(677,"lv_timer_ready")
ZION_AUTO_IMPORT(678,"lv_timer_reset")
ZION_AUTO_IMPORT(679,"lv_timer_resume")
ZION_AUTO_IMPORT(680,"lv_timer_set_period")
ZION_AUTO_IMPORT(681,"lv_timer_set_repeat_count")
ZION_AUTO_IMPORT(682,"lvgl_port_add_disp")
ZION_AUTO_IMPORT(683,"lvgl_port_init")
ZION_AUTO_IMPORT(684,"lvgl_port_lock")
ZION_AUTO_IMPORT(685,"lvgl_port_unlock")
ZION_AUTO_IMPORT(686,"lwip_bind")
ZION_AUTO_IMPORT(687,"lwip_connect")
ZION_AUTO_IMPORT(688,"lwip_fcntl")
ZION_AUTO_IMPORT(689,"lwip_freeaddrinfo")
ZION_AUTO_IMPORT(690,"lwip_getaddrinfo")
ZION_AUTO_IMPORT(691,"lwip_getsockname")
ZION_AUTO_IMPORT(692,"lwip_getsockopt")
ZION_AUTO_IMPORT(693,"lwip_inet_ntop")
ZION_AUTO_IMPORT(694,"lwip_inet_pton")
ZION_AUTO_IMPORT(695,"lwip_recv")
ZION_AUTO_IMPORT(696,"lwip_recvfrom")
ZION_AUTO_IMPORT(697,"lwip_select")
ZION_AUTO_IMPORT(698,"lwip_send")
ZION_AUTO_IMPORT(699,"lwip_sendto")
ZION_AUTO_IMPORT(700,"lwip_setsockopt")
ZION_AUTO_IMPORT(701,"lwip_shutdown")
ZION_AUTO_IMPORT(702,"lwip_socket")
ZION_AUTO_IMPORT(703,"lwip_socket_thread_cleanup")
ZION_AUTO_IMPORT(704,"malloc")
ZION_AUTO_IMPORT(705,"mbedtls_base64_decode")
ZION_AUTO_IMPORT(706,"mbedtls_base64_encode")
ZION_AUTO_IMPORT(707,"mbedtls_ecp_check_pubkey")
ZION_AUTO_IMPORT(708,"mbedtls_ecp_gen_keypair")
ZION_AUTO_IMPORT(709,"mbedtls_ecp_group_init")
ZION_AUTO_IMPORT(710,"mbedtls_ecp_group_load")
ZION_AUTO_IMPORT(711,"mbedtls_ecp_mul")
ZION_AUTO_IMPORT(712,"mbedtls_ecp_point_free")
ZION_AUTO_IMPORT(713,"mbedtls_ecp_point_init")
ZION_AUTO_IMPORT(714,"mbedtls_ecp_point_read_binary")
ZION_AUTO_IMPORT(715,"mbedtls_ecp_point_write_binary")
ZION_AUTO_IMPORT(716,"mbedtls_gcm_auth_decrypt")
ZION_AUTO_IMPORT(717,"mbedtls_gcm_crypt_and_tag")
ZION_AUTO_IMPORT(718,"mbedtls_gcm_free")
ZION_AUTO_IMPORT(719,"mbedtls_gcm_init")
ZION_AUTO_IMPORT(720,"mbedtls_gcm_setkey")
ZION_AUTO_IMPORT(721,"mbedtls_md")
ZION_AUTO_IMPORT(722,"mbedtls_md_hmac")
ZION_AUTO_IMPORT(723,"mbedtls_md_info_from_type")
ZION_AUTO_IMPORT(724,"mbedtls_mpi_free")
ZION_AUTO_IMPORT(725,"mbedtls_mpi_init")
ZION_AUTO_IMPORT(726,"mbedtls_mpi_write_binary")
ZION_AUTO_IMPORT(727,"mbedtls_platform_zeroize")
ZION_AUTO_IMPORT(728,"memchr")
ZION_AUTO_IMPORT(729,"memmove")
ZION_AUTO_IMPORT(730,"mktime")
ZION_AUTO_IMPORT(731,"netconn_gethostbyname")
ZION_AUTO_IMPORT(732,"nimble_port_deinit")
ZION_AUTO_IMPORT(733,"nimble_port_freertos_deinit")
ZION_AUTO_IMPORT(734,"nimble_port_freertos_init")
ZION_AUTO_IMPORT(735,"nimble_port_get_dflt_eventq")
ZION_AUTO_IMPORT(736,"nimble_port_init")
ZION_AUTO_IMPORT(737,"nimble_port_run")
ZION_AUTO_IMPORT(738,"nimble_port_stop")
ZION_AUTO_IMPORT(739,"npl_funcs")
ZION_AUTO_IMPORT(740,"nvs_erase_all")
ZION_AUTO_IMPORT(741,"nvs_erase_key")
ZION_AUTO_IMPORT(742,"nvs_flash_erase")
ZION_AUTO_IMPORT(743,"nvs_get_blob")
ZION_AUTO_IMPORT(744,"nvs_get_i16")
ZION_AUTO_IMPORT(745,"nvs_get_i64")
ZION_AUTO_IMPORT(746,"nvs_get_i8")
ZION_AUTO_IMPORT(747,"nvs_get_stats")
ZION_AUTO_IMPORT(748,"nvs_get_str")
ZION_AUTO_IMPORT(749,"nvs_get_u16")
ZION_AUTO_IMPORT(750,"nvs_get_u32")
ZION_AUTO_IMPORT(751,"nvs_get_u8")
ZION_AUTO_IMPORT(752,"nvs_set_blob")
ZION_AUTO_IMPORT(753,"nvs_set_i16")
ZION_AUTO_IMPORT(754,"nvs_set_i64")
ZION_AUTO_IMPORT(755,"nvs_set_i8")
ZION_AUTO_IMPORT(756,"nvs_set_str")
ZION_AUTO_IMPORT(757,"nvs_set_u16")
ZION_AUTO_IMPORT(758,"nvs_set_u32")
ZION_AUTO_IMPORT(759,"nvs_set_u8")
ZION_AUTO_IMPORT(760,"opendir")
ZION_AUTO_IMPORT(761,"opus_decode")
ZION_AUTO_IMPORT(762,"opus_decoder_get_size")
ZION_AUTO_IMPORT(763,"opus_decoder_init")
ZION_AUTO_IMPORT(764,"opus_encoder_create")
ZION_AUTO_IMPORT(765,"opus_encoder_destroy")
ZION_AUTO_IMPORT(766,"opus_encoder_get_size")
ZION_AUTO_IMPORT(767,"opus_encoder_init")
ZION_AUTO_IMPORT(768,"os_mbuf_append")
ZION_AUTO_IMPORT(769,"os_msys_num_free")
ZION_AUTO_IMPORT(770,"pcTaskGetName")
ZION_AUTO_IMPORT(771,"pow")
ZION_AUTO_IMPORT(772,"powf")
ZION_AUTO_IMPORT(773,"printf")
ZION_AUTO_IMPORT(774,"psa_crypto_init")
ZION_AUTO_IMPORT(775,"psa_destroy_key")
ZION_AUTO_IMPORT(776,"psa_export_key")
ZION_AUTO_IMPORT(777,"psa_export_public_key")
ZION_AUTO_IMPORT(778,"psa_generate_key")
ZION_AUTO_IMPORT(779,"psa_generate_random")
ZION_AUTO_IMPORT(780,"psa_hash_abort")
ZION_AUTO_IMPORT(781,"psa_hash_compute")
ZION_AUTO_IMPORT(782,"psa_hash_finish")
ZION_AUTO_IMPORT(783,"psa_hash_setup")
ZION_AUTO_IMPORT(784,"psa_hash_update")
ZION_AUTO_IMPORT(785,"psa_import_key")
ZION_AUTO_IMPORT(786,"psa_mac_abort")
ZION_AUTO_IMPORT(787,"psa_mac_sign_finish")
ZION_AUTO_IMPORT(788,"psa_mac_sign_setup")
ZION_AUTO_IMPORT(789,"psa_mac_update")
ZION_AUTO_IMPORT(790,"psa_raw_key_agreement")
ZION_AUTO_IMPORT(791,"psa_reset_key_attributes")
ZION_AUTO_IMPORT(792,"pthread_mutex_destroy")
ZION_AUTO_IMPORT(793,"pthread_mutex_init")
ZION_AUTO_IMPORT(794,"pthread_mutex_lock")
ZION_AUTO_IMPORT(795,"pthread_mutex_unlock")
ZION_AUTO_IMPORT(796,"readdir")
ZION_AUTO_IMPORT(797,"realloc")
ZION_AUTO_IMPORT(798,"remove")
ZION_AUTO_IMPORT(799,"rename")
ZION_AUTO_IMPORT(800,"rewind")
ZION_AUTO_IMPORT(801,"select")
ZION_AUTO_IMPORT(802,"setenv")
ZION_AUTO_IMPORT(803,"settimeofday")
ZION_AUTO_IMPORT(804,"setvbuf")
ZION_AUTO_IMPORT(805,"sin")
ZION_AUTO_IMPORT(806,"sinf")
ZION_AUTO_IMPORT(807,"sntp_set_time_sync_notification_cb")
ZION_AUTO_IMPORT(808,"spi_bus_initialize")
ZION_AUTO_IMPORT(809,"sqrt")
ZION_AUTO_IMPORT(810,"sqrtf")
ZION_AUTO_IMPORT(811,"sscanf")
ZION_AUTO_IMPORT(812,"stat")
ZION_AUTO_IMPORT(813,"stdin")
ZION_AUTO_IMPORT(814,"stdout")
ZION_AUTO_IMPORT(815,"strcasecmp")
ZION_AUTO_IMPORT(816,"strcasestr")
ZION_AUTO_IMPORT(817,"strcat")
ZION_AUTO_IMPORT(818,"strchr")
ZION_AUTO_IMPORT(819,"strcmp")
ZION_AUTO_IMPORT(820,"strcpy")
ZION_AUTO_IMPORT(821,"strcspn")
ZION_AUTO_IMPORT(822,"strdup")
ZION_AUTO_IMPORT(823,"strerror")
ZION_AUTO_IMPORT(824,"strftime")
ZION_AUTO_IMPORT(825,"strlcat")
ZION_AUTO_IMPORT(826,"strlcpy")
ZION_AUTO_IMPORT(827,"strncasecmp")
ZION_AUTO_IMPORT(828,"strncat")
ZION_AUTO_IMPORT(829,"strncmp")
ZION_AUTO_IMPORT(830,"strncpy")
ZION_AUTO_IMPORT(831,"strnlen")
ZION_AUTO_IMPORT(832,"strpbrk")
ZION_AUTO_IMPORT(833,"strrchr")
ZION_AUTO_IMPORT(834,"strstr")
ZION_AUTO_IMPORT(835,"strtod")
ZION_AUTO_IMPORT(836,"strtok")
ZION_AUTO_IMPORT(837,"strtol")
ZION_AUTO_IMPORT(838,"strtoll")
ZION_AUTO_IMPORT(839,"strtoul")
ZION_AUTO_IMPORT(840,"strtoull")
ZION_AUTO_IMPORT(841,"time")
ZION_AUTO_IMPORT(842,"tolower")
ZION_AUTO_IMPORT(843,"toupper")
ZION_AUTO_IMPORT(844,"tzset")
ZION_AUTO_IMPORT(845,"ulTaskGenericNotifyTake")
ZION_AUTO_IMPORT(846,"usb_serial_jtag_driver_install")
ZION_AUTO_IMPORT(847,"usb_serial_jtag_is_driver_installed")
ZION_AUTO_IMPORT(848,"usb_serial_jtag_read_bytes")
ZION_AUTO_IMPORT(849,"usb_serial_jtag_vfs_use_driver")
ZION_AUTO_IMPORT(850,"usb_serial_jtag_write_bytes")
ZION_AUTO_IMPORT(851,"uxQueueMessagesWaiting")
ZION_AUTO_IMPORT(852,"uxTaskGetStackHighWaterMark")
ZION_AUTO_IMPORT(853,"vEventGroupDelete")
ZION_AUTO_IMPORT(854,"vPortEnterCritical")
ZION_AUTO_IMPORT(855,"vPortExitCritical")
ZION_AUTO_IMPORT(856,"vRingbufferDelete")
ZION_AUTO_IMPORT(857,"vRingbufferReturnItem")
ZION_AUTO_IMPORT(858,"vStreamBufferDelete")
ZION_AUTO_IMPORT(859,"vTaskPrioritySet")
ZION_AUTO_IMPORT(860,"vTaskSuspend")
ZION_AUTO_IMPORT(861,"vsnprintf")
ZION_AUTO_IMPORT(862,"xEventGroupClearBits")
ZION_AUTO_IMPORT(863,"xEventGroupCreate")
ZION_AUTO_IMPORT(864,"xEventGroupSetBits")
ZION_AUTO_IMPORT(865,"xEventGroupWaitBits")
ZION_AUTO_IMPORT(866,"xPortInIsrContext")
ZION_AUTO_IMPORT(867,"xQueueCreateMutex")
ZION_AUTO_IMPORT(868,"xQueueCreateMutexStatic")
ZION_AUTO_IMPORT(869,"xQueueGenericCreateStatic")
ZION_AUTO_IMPORT(870,"xQueueGenericReset")
ZION_AUTO_IMPORT(871,"xQueueGiveMutexRecursive")
ZION_AUTO_IMPORT(872,"xQueueSemaphoreTake")
ZION_AUTO_IMPORT(873,"xQueueTakeMutexRecursive")
ZION_AUTO_IMPORT(874,"xRingbufferCreateStatic")
ZION_AUTO_IMPORT(875,"xRingbufferReceive")
ZION_AUTO_IMPORT(876,"xRingbufferSend")
ZION_AUTO_IMPORT(877,"xStreamBufferBytesAvailable")
ZION_AUTO_IMPORT(878,"xStreamBufferGenericCreate")
ZION_AUTO_IMPORT(879,"xStreamBufferReceive")
ZION_AUTO_IMPORT(880,"xStreamBufferSend")
ZION_AUTO_IMPORT(881,"xTaskCreateStaticPinnedToCore")
ZION_AUTO_IMPORT(882,"xTaskGenericNotify")
ZION_AUTO_IMPORT(883,"xTaskGenericNotifyWait")
ZION_AUTO_IMPORT(884,"xTaskGetCurrentTaskHandle")
ZION_AUTO_IMPORT(885,"xTaskGetHandle")
ZION_AUTO_IMPORT(886,"xTaskGetTickCount")
