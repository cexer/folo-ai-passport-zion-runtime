/* Deliberate, reviewed imports. Never export flash erase, reset, raw drivers or
 * arbitrary ELF addresses. These names are a same-build ABI, not a stable SDK. */
ZION_IMPORT(bsp_i2c_init,compat_init)
ZION_IMPORT(bsp_display_init,compat_init)
ZION_IMPORT(bsp_lvgl_init,compat_lvgl_init)
ZION_IMPORT(bsp_battery_init,compat_init)
ZION_IMPORT(bsp_button_init,compat_button_init)
ZION_IMPORT(zion_idf_configure_buttons,bsp_button_configure_ranges)
ZION_IMPORT(zion_idf_configure_button_events,configure_button_events)
ZION_IMPORT(zion_idf_configure_button_release,configure_button_release)
ZION_IMPORT(nvs_flash_init,compat_init)
ZION_IMPORT(bsp_lvgl_lock,bsp_lvgl_lock)
ZION_IMPORT(bsp_lvgl_unlock,bsp_lvgl_unlock)
ZION_IMPORT(bsp_display_backlight,bsp_display_backlight)
ZION_IMPORT(bsp_battery_soc,bsp_battery_soc)
ZION_IMPORT(esp_timer_get_time,esp_timer_get_time)
ZION_IMPORT(esp_get_free_heap_size,esp_get_free_heap_size)
ZION_IMPORT(esp_log_timestamp,esp_log_timestamp)
ZION_IMPORT(esp_log,esp_log)
ZION_IMPORT(esp_log_write,esp_log_write)
ZION_IMPORT(_esp_error_check_failed,_esp_error_check_failed)
ZION_IMPORT(xQueueGenericCreate,xQueueGenericCreate)
ZION_IMPORT(xQueueGenericSend,xQueueGenericSend)
ZION_IMPORT(xQueueReceive,xQueueReceive)
ZION_IMPORT(vQueueDelete,vQueueDelete)
ZION_IMPORT(xTaskCreate,xTaskCreate)
ZION_IMPORT(xTaskCreatePinnedToCore,xTaskCreatePinnedToCore)
ZION_IMPORT(vTaskDelay,vTaskDelay)
ZION_IMPORT(vTaskDelete,vTaskDelete)
ZION_IMPORT(nvs_open,nvs_open)
ZION_IMPORT(nvs_close,nvs_close)
ZION_IMPORT(nvs_get_i32,nvs_get_i32)
ZION_IMPORT(nvs_set_i32,nvs_set_i32)
ZION_IMPORT(nvs_commit,nvs_commit)
ZION_IMPORT(start_dns_server,zion_idf_dns_start)
ZION_IMPORT(stop_dns_server,zion_idf_dns_stop)
ZION_IMPORT(esp_ota_get_next_update_partition,zion_idf_ota_next)
ZION_IMPORT(esp_ota_begin,zion_idf_ota_begin)
ZION_IMPORT(esp_ota_write,zion_idf_ota_write)
ZION_IMPORT(esp_ota_abort,zion_idf_ota_abort)
ZION_IMPORT(esp_ota_end,zion_idf_ota_end)
ZION_IMPORT(esp_ota_set_boot_partition,zion_idf_ota_boot)
ZION_IMPORT(esp_ota_mark_app_valid_cancel_rollback,zion_idf_ota_valid)
ZION_IMPORT(lv_obj_create,lv_obj_create)
ZION_IMPORT(lv_color_hex,lv_color_hex)
ZION_IMPORT(lv_obj_set_pos,lv_obj_set_pos)
ZION_IMPORT(lv_obj_set_size,lv_obj_set_size)
ZION_IMPORT(lv_obj_set_width,lv_obj_set_width)
ZION_IMPORT(lv_obj_set_height,lv_obj_set_height)
ZION_IMPORT(lv_obj_set_style_bg_color,lv_obj_set_style_bg_color)
ZION_IMPORT(lv_obj_set_style_bg_opa,lv_obj_set_style_bg_opa)
ZION_IMPORT(lv_obj_set_style_text_color,lv_obj_set_style_text_color)
ZION_IMPORT(lv_obj_set_style_text_font,lv_obj_set_style_text_font)
ZION_IMPORT(lv_label_create,lv_label_create)
ZION_IMPORT(lv_label_set_text,lv_label_set_text)
ZION_IMPORT(lv_screen_load,lv_screen_load)
ZION_IMPORT(lv_font_unscii_8,lv_font_unscii_8)
ZION_IMPORT(snprintf,snprintf)
ZION_IMPORT(zion_idf_run_initializers,zion_idf_run_initializers)

ZION_IMPORT(zion_idf_errno,zion_idf_errno)
